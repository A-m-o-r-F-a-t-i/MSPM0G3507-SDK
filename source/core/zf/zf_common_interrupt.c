/*****************************************

* 文件名称          zf_common_interrupt

****************************************/

#include "zf_common_interrupt.h"

static uint32 interrupt_nest_count = 0;

//-------------------------------------------------------------------------------------------------------------------
// 函数简介     全局中断使能
// 参数说明     primask         当前屏蔽嵌套层数
// 返回参数     void
// 使用示例     interrupt_global_enable(primask);
// 备注信息
//-------------------------------------------------------------------------------------------------------------------
void interrupt_global_enable(uint32 primask)
{
    if (primask)
    {
        interrupt_nest_count--;
    }
    if (!interrupt_nest_count)
    {
        __ASM volatile("cpsie i");
    }
}

//-------------------------------------------------------------------------------------------------------------------
// 函数简介     全局中断屏蔽
// 参数说明     void
// 返回参数     uint32          当前屏蔽嵌套层数
// 使用示例     primask = interrupt_global_disable();
// 备注信息
//-------------------------------------------------------------------------------------------------------------------
uint32 interrupt_global_disable(void)
{
    if (!interrupt_nest_count)
    {
        __ASM volatile("cpsid i");
    }
    interrupt_nest_count++;
    return interrupt_nest_count;
}

//-------------------------------------------------------------------------------------------------------------------
// 函数简介     指定中断使能
// 参数说明     irqn            指定中断号 可查看 isr.c 对应中断服务函数的标注
// 返回参数     void
// 使用示例     interrupt_enable(UART1_IRQn);
// 备注信息
//-------------------------------------------------------------------------------------------------------------------
void interrupt_enable(IRQn_Type irqn)
{
    NVIC_EnableIRQ(irqn);
}

//-------------------------------------------------------------------------------------------------------------------
// 函数简介     指定中断屏蔽
// 参数说明     irqn            指定中断号 可查看 isr.c 对应中断服务函数的标注
// 返回参数     void
// 使用示例     interrupt_disable(UART1_IRQn);
// 备注信息
//-------------------------------------------------------------------------------------------------------------------
void interrupt_disable(IRQn_Type irqn)
{
    NVIC_DisableIRQ(irqn);
}

//-------------------------------------------------------------------------------------------------------------------
// 函数简介     指定中断设置优先级
// 参数说明     irqn            指定中断号 可查看 isr.c 对应中断服务函数的标注
// 参数说明     priority        中断优先级 0-7 值越小，优先级越高
// 返回参数     void
// 使用示例     interrupt_set_priority(UART1_IRQn, 0);
// 备注信息
//-------------------------------------------------------------------------------------------------------------------
void interrupt_set_priority(IRQn_Type irqn, uint8 priority)
{
    NVIC_SetPriority(irqn, priority);
}

//-------------------------------------------------------------------------------------------------------------------
// 函数简介     中断组初始化
// 参数说明     void
// 返回参数     void
// 使用示例     interrupt_init();
// 备注信息     会在  clock_init 内部调用
//-------------------------------------------------------------------------------------------------------------------
void interrupt_init(void)
{
    NVIC_SetPriorityGrouping(4);
}
